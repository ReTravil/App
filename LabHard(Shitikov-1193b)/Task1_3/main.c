//------------------------------------------------------------------------------------------------------------------------------------------------------------------------
//Разработчик проекта: Шитиков Дмитрий Андреевич - ИЦЭ, студент группы 1193б
//
//Цель: разработать программу для вывода чисел в 14-ую систему счисления на семисегментном индикаторе
//
//Решаемые проектом задачи:
//   1. На основе константных и варьируемых бит определять значение числа в десятичной системе счисления
//   2. Преобразовывать число из десятичной системы счисления в систему с основанием четыре
//   3. Кодировать каждую цифру числа символом для семисегментного индикатора
//   4. Выводить все цифры числа на семисегментном индикаторе, начиная со старшей цифры.
//------------------------------------------------------------------------------------------------------------------------------------------------------------------------

#include "main.h"      // Заголовочный файл с описанием подключаемых библиотечных модулей

//main обязательная функция для исполнегия кода пользователя
//После подачи питания или щелчка кнопкой "reset" стартует Загрузкчик, который выполняет начальную настройку основых регистров микроконтроллера
//В завершение работы Загрузчик передаёт управление микроконтроллером функции main
int main(void)
{
//Конфигурирование портов GPIO
RCC->AHBENR |= RCC_AHBENR_GPIOBEN;                                                           //Включение тактирования порта B: RCC_AHBENR_GPIOBEN=0x00040000
GPIOB->OSPEEDR |= 0x00005555;                                                                //установка частоты переключения выводов PB.0 – PB.7 на уровне 10 МГц
GPIOB->MODER |= GPIO_MODER_MODER0_0 | GPIO_MODER_MODER1_0 | GPIO_MODER_MODER2_0 |            //Переключаем линий 0-7 и 9 порта B в режим "Output"
GPIO_MODER_MODER3_0 | GPIO_MODER_MODER4_0 | GPIO_MODER_MODER5_0 |
GPIO_MODER_MODER6_0 | GPIO_MODER_MODER7_0 | GPIO_MODER_MODER9_0;
GPIOB->MODER&=~( GPIO_MODER_MODER12 | GPIO_MODER_MODER13 |
GPIO_MODER_MODER14 | GPIO_MODER_MODER15);                                                    //Переключаем линий 12(SW4),13(SW3),14(SW2),15(SW1)порта B в режим "Input"

uint16_t input[8] = {0, 1, 0, 0, 0, 1, 1, 0} ;                                               //Входное значение числа (в двоичной системе)
uint16_t n = 0;                                                                              //Значение числа в десятичной системе
uint16_t output[3] = {0,0,0};                                                              //Массив с числом в четверичной системе (в обратном порядке)
unsigned reg[14] = {0x23F, 0x206, 0x25B, 0x24F, 0x266, 0x26D, 0x27D, 0x207, 0x27F, 0x26F, 0x277, 0x27C, 0x239, 0x25E};                          //Регистры семисегментного индикатора, цифры 0,1,2,3 соответственно
//Реализация вывода на семисегментный индикатор
while(1)
{
n=0;
input[2]=((GPIOB->IDR)&0x8000)>>15;                                                          //Считывание значения переключателя SW1
input[3]=((GPIOB->IDR)&0x4000)>>14;                                                          //Считывание значения переключателя SW2
input[4]=((GPIOB->IDR)&0x2000)>>13;                                                          //Считывание значения переключателя SW3
input[7]=((GPIOB->IDR)&0x1000)>>12;                                                          //Считывание значения переключателя SW4
uint32_t j=7;                                                                                //Разряд двоичного числа
//Перевод числа в десятичную систему
for (uint16_t i = 0 ; i<8; i++)
{
n += input[i]* powi (2, j);                                                                  //расчёт числа в десятичной системе
j--;                                                                                         //переход к следующему разряду
}
//Перевод числа в 14-ую систему
for (uint16_t i = 0 ; i<14; i++)
{
if(n<14) 
{                                                                                            //условие срабатывает, если десятичное число меньше разрядности
output[i] = n;                                                                               //в выходной массив записывается значение числа
break;                                                                                       //цикл прерывается
}
output[i] = n%14;                                                                             //в выходной массив записывается остаток от деления на 14
n = n/14;                                                                                     //в число n записывается целая часть от деления
}
//вывод числа на семисегментном индикаторе
for (int16_t i =3; i>=0; i--)
{
if(i == 3 & output[i]== 0){                                                                  //отбрасываем 0 в старшей цифре числа (если он есть)
continue;}
GPIOB->BSRR|=reg[output[i]];                                                                 //ввыод цифры числа
delay(200000);                                                                               //задержка в 2 секунды
GPIOB->BSRR|=0xffff0000;                                                                     //гашение индикатора
delay(50000);                                                                                //задержка в 0,5 секунды
}
GPIOB->BSRR|=0x00000280;                                                                     //вывод точки
delay(500000);                                                                               //задержка в 5 секунд
GPIOB->BSRR|=0xffff0000;                                                                     //гашение индикатора
}
}

//powi функция для вычисления степени числа
//x - число кторое нужно возвести в степень, n - степень в которую нужно возвести
//возвращает число возведённое в степень
uint32_t powi(uint32_t x, uint32_t n)
{
if (n==0)                                                                                    //если степень равна 0
return 1;                                                                                    //возвращается единица
else if (n==1)                                                                               //если степень равна 1
return x;                                                                                    //возвращается искомое число
else if (n % 2 == 0 )                                                                        //если степень чётная
return powi( x * x, n/2);                                                                    //производится рекурсия, передаётся число умноженное на себя и половина степени
else                                                                                         //если степень нечётная
return powi( x * x, n /2)*x;                                                                 //производится рекурсия, передаётся число умноженное на себя и половина степени и результат умножнается на искомое число
}

void delay(uint32_t count)                                                                   //функция задержки: count - количество элементарных периодов задержки с длительностью примерно 2,5 мкс
{
volatile uint32_t i;                                                                         //объявляем неоптимизируемую переменную
for (i =0;i<count;i++);                                                                      //выполнение пустых циклов для реализации програмной задержки
}
//----------------------------------------------------------------------------------------------------------------------------------------------
//Руководство пользователя:
// 1. Для запуска загруженной программы удалите перемычку "boot" на стенде и нажмите "reset"
// 2. Число задаётся с помощью переключателей SW1, SW2, SW3, SW4
// 3. Задаваемое число имеет вид: 0 1 (SW1) (SW2) (SW3) 1 1 (SW4)
// 4. На семисегментном индикаторе, начиная со старшей цифры, выводится число, в окончании выводится точка
//----------------------------------------------------------------------------------------------------------------------------------------------

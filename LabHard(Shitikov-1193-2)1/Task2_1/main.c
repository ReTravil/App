/*------------------------------------------------------------------------------------------------------------------------------------------------------------------------
**Проект: "USART-Эхо".
**Назначение программы: принять по USART пакеты данных от ПК и вернуть их обратно
**Разработчик проекта: Шитиков Дмитрий Андреевич - ИЦЭ, студент группы 1193б
**Цель: изучить принципиальное устройство и основы программирования USART у микроконтроллеров с архитектурой ARM7.
**Решаемые проектом задачи:
**   1. Конфигурирование линий GPIO на выполнения альтернативных функций;
**   2. Конфигурирование USART;
**   3. Демонстрация базовых принципов приема и передачи данных с помощью интерфейса USART (без использования прерываний).
**------------------------------------------------------------------------------------------------------------------------------------------------------------------------*/
#include "main.h"

int main(void)
{
	InitUSART1(); //Инициализиция USART1 лабораторного комплекса STM_01
	while(1)
	{
		//Получение данных из USART
		while ((USART1->ISR & USART_ISR_RXNE) == 0) { } //Чтение регистра состояния ISR и анализ флага RXNE: RXNE выставляется USART в 1, когда новый пакет данных получен приемником Rx и скопирован в RDR
		uint8_t d = (uint8_t)USART1->RDR; 							//Копирование данных из USART (регистр RDR) в программную переменную.
		//Чтение регистра RDR приводит к сбросу флага RXNE=0. После чего USART снова получает возможность просигналить программе о получении нового пакета от ПК.
		
		//Отправка данных в USART
		while ((USART1->ISR & USART_ISR_TXE) == 0) { } /*Чтение регистра состояния ISR и анализ флага TXE:
																										TXE=0, пока данные из регистра TDR не скопированы в сдвиговый регистр передатчика Tx.
																										TXE автоматически выставляется в USART в 1, когда копирование из TDR в сдвиговый регистр завершено
																										и регистр TDR готов к получению следующего пакета*/
		USART1->TDR = d; //Передача данных из программной переменной в USART (регистр TDR).
		//Запись в регистр TDR приводит к сбросу флага TXE=0.
	}
}
//Функция инициализации USART лабораторного комлекса STM_01
void InitUSART1(void)
{
	//Включение тактирования USART1
	RCC->APB2ENR|=RCC_APB2ENR_USART1EN; 					//RCC_APB2ENR_USART1EN=0x00004000;
	//Включение тактирования порта А
	RCC->AHBENR|=RCC_AHBENR_GPIOAEN; 							//RCC_AHBENR_GPIOAEN=0x00020000
	//Настройка линии порта А: PA9(TX_1) - выход передатчика; PA10 (RX_1) - вход приемника
	GPIOA->MODER|=0x00280000; 										//Перевести линии PA9 и PA10 в режим альтернативной функции
	GPIOA->AFR[1]|=0x00000110; 										//Включить на линиях PA9 и PA10 альтернативную функцию AF1
	//Настройка линии передатчика Tx (PA9)
	GPIOA->OTYPER&=~GPIO_OTYPER_OT_9; 						//Сбросить 9 бит GPIOA->OTYPER - переключение в режим push-pull для линии PA9 (активный выход)
	GPIOA->PUPDR&=~GPIO_PUPDR_PUPDR9; 						//Отключение подтягивающих резисторов для линий PA9
	GPIOA->OSPEEDR&=~GPIO_OSPEEDR_OSPEEDR9; 			//Установка высокой скорости синхронизации линий PA9
	//Настройка линии приемника Rx (PA10)
	GPIOA->PUPDR&=~GPIO_PUPDR_PUPDR10; 						//Сброс режима подтягивающих резисторов для линий PA10
	GPIOA->PUPDR&=~GPIO_PUPDR_PUPDR10_0; 					//Включение подтягивающего резистора pull-up на входной линии PA10 (вход приемника Rx)
	//Конфигурирование USART
	USART1->CR1&=~USART_CR1_UE; 	//Запрещение работы модуля USART1 для изменения параметров его конфигурации
	USART1->BRR=69; 							/*Настройка делителя частоты, тактирующего USART и задающего скорость приема и передачи данных на уровне 115200 бит/c: Частота тактирующего генератора = 8 МГц;
																  Скорость обмена по USART = 115200 бит/c; коэффициент деления = 8000000 / 115200 = 69,4444(4); Округленное значение = 69*/
	USART1->CR1=USART_CR1_TE|USART_CR1_RE; /*Разрешить работу приемника и передатчика USART. Остальные биты этого регистра сброшены, что обеспечивает: количество бит данных в пакете = 8;
																					 контроль четности - отключен; прерывания по любым флагам USART - запрещены; состояние USART - отключен*/
	USART1->CR2=0; 												 //Количество стоповых бит - 1
	USART1->CR3=0; 											   //DMA1 - отключен
	USART1->CR1|=USART_CR1_UE;  					 //По завешении конфигурирования USART разрешить его работу (биту UE регистра CR1 присвоить 1).
	//Примечание: конфигурирование USART можно выполнять только в не активном состоянии: UE=0.
}
/*------------------------------------------------------------------------------------------------------------------------------------------------------------------------
**Руководство пользователя:.
**   1. Запустите программу на лабораторном комплексе STM_01;
**   2. На компьютере запустите любую программу для мониторинга последовательных портов ПК (Terminal, PuTTY или др.) и подключитесь к соответствующему COM-порту на скорости 115200 бит/c;
**   3. С помощью программы мониторинга отправьте на лабораторный стенд произвольный набор символов и отследите эхо-символы, вернувшиеся обратно
**------------------------------------------------------------------------------------------------------------------------------------------------------------------------*/
